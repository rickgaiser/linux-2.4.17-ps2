## crypto/Config.in
```kconfig
#
# Crypto Library Configuration
#
mainmenu_option next_comment
comment 'Cryptographic options'

bool 'Cryptographic API support' CONFIG_CRYPTO

source crypto/cryptoloop/Config.in

dep_tristate 'Cryptographic ciphers' CONFIG_CIPHERS $CONFIG_CRYPTO
source crypto/ciphers/Config.in

dep_tristate 'Digest algorithms' CONFIG_DIGESTS $CONFIG_CRYPTO
source crypto/digests/Config.in

endmenu
```

## drivers/char/Config.in
```kconfig
#
# Character device configuration
#
mainmenu_option next_comment
comment 'Character devices'

bool 'Virtual terminal' CONFIG_VT
if [ "$CONFIG_VT" = "y" ]; then
   bool '  Support for console on virtual terminal' CONFIG_VT_CONSOLE
fi
if [ "$CONFIG_SNSC" = "y" ]; then
   bool 'Support for NULL console' CONFIG_NULL_CONSOLE 
   if [ "$CONFIG_DUMMY_KEYB" = "y" ]; then
       bool 'Support for keycodes translation in DUMMY KEYB driver' CONFIG_DUMMY_KEYB_TRANS_SCANCODES
   fi
fi

tristate 'Standard/generic (8250/16550 and compatible UARTs) serial support' CONFIG_SERIAL
if [ "$CONFIG_SERIAL" = "y" ]; then
   bool '  Support for console on serial port' CONFIG_SERIAL_CONSOLE
   if [ "$CONFIG_ARCH_ACORN" = "y" ]; then
      tristate '   Atomwide serial port support' CONFIG_ATOMWIDE_SERIAL
      tristate '   Dual serial port support' CONFIG_DUALSP_SERIAL
   fi
fi
if [ "$CONFIG_ACPI" = "y" ]; then
   bool '  Support for serial ports defined by ACPI tables' CONFIG_SERIAL_ACPI
fi
dep_mbool 'Extended dumb serial driver options' CONFIG_SERIAL_EXTENDED $CONFIG_SERIAL
if [ "$CONFIG_SERIAL_EXTENDED" = "y" ]; then
   bool '  Support more than 4 serial ports' CONFIG_SERIAL_MANY_PORTS
   bool '  Support for sharing serial interrupts' CONFIG_SERIAL_SHARE_IRQ
   bool '  Autodetect IRQ on standard ports (unsafe)' CONFIG_SERIAL_DETECT_IRQ
   bool '  Support special multiport boards' CONFIG_SERIAL_MULTIPORT
   bool '  Support the Bell Technologies HUB6 card' CONFIG_HUB6
fi
bool 'Non-standard serial port support' CONFIG_SERIAL_NONSTANDARD
if [ "$CONFIG_SERIAL_NONSTANDARD" = "y" ]; then
   tristate '  Computone IntelliPort Plus serial support' CONFIG_COMPUTONE
   tristate '  Comtrol Rocketport support' CONFIG_ROCKETPORT
   tristate '  Cyclades async mux support' CONFIG_CYCLADES
   if [ "$CONFIG_EXPERIMENTAL" = "y" -a "$CONFIG_CYCLADES" != "n" ]; then
      bool '    Cyclades-Z interrupt mode operation (EXPERIMENTAL)' CONFIG_CYZ_INTR
   fi
   tristate '  Digiboard Intelligent Async Support' CONFIG_DIGIEPCA
   if [ "$CONFIG_DIGIEPCA" = "n" ]; then
      tristate '  Digiboard PC/Xx Support' CONFIG_DIGI
   fi
   tristate '  Hayes ESP serial port support' CONFIG_ESPSERIAL
   tristate '  Moxa Intellio support' CONFIG_MOXA_INTELLIO
   tristate '  Moxa SmartIO support' CONFIG_MOXA_SMARTIO
   if [ "$CONFIG_EXPERIMENTAL" = "y" ]; then
      dep_tristate '  Multi-Tech multiport card support (EXPERIMENTAL)' CONFIG_ISI m
   fi
   tristate '  Microgate SyncLink card support' CONFIG_SYNCLINK
   tristate '  HDLC line discipline support' CONFIG_N_HDLC
   tristate '  SDL RISCom/8 card support' CONFIG_RISCOM8
   tristate '  Specialix IO8+ card support' CONFIG_SPECIALIX
   if [ "$CONFIG_SPECIALIX" != "n" ]; then
      bool '  Specialix DTR/RTS pin is RTS' CONFIG_SPECIALIX_RTSCTS
   fi 
   tristate '  Specialix SX (and SI) card support' CONFIG_SX
   tristate '  Specialix RIO system support' CONFIG_RIO
   if [ "$CONFIG_RIO" != "n" ]; then
     bool '    Support really old RIO/PCI cards' CONFIG_RIO_OLDPCI
   fi
   bool '  Stallion multiport serial support' CONFIG_STALDRV
   if [ "$CONFIG_STALDRV" = "y" ]; then
     tristate '    Stallion EasyIO or EC8/32 support' CONFIG_STALLION
     tristate '    Stallion EC8/64, ONboard, Brumby support' CONFIG_ISTALLION
   fi
   if [ "$CONFIG_MIPS" = "y" ]; then
     bool '  TMPTX3912/PR31700 serial port support' CONFIG_SERIAL_TX3912
     dep_bool '     Console on TMPTX3912/PR31700 serial port' CONFIG_SERIAL_TX3912_CONSOLE $CONFIG_SERIAL_TX3912
     bool '  Enable Au1000 UART Support' CONFIG_AU1000_UART
     if [ "$CONFIG_AU1000_UART" = "y" ]; then
         bool '        Enable Au1000 serial console' CONFIG_AU1000_SERIAL_CONSOLE
     fi
     bool 'TXx927 SIO support' CONFIG_TXX927_SERIAL 
     if [ "$CONFIG_TXX927_SERIAL" = "y" ]; then
        bool 'TXx927 SIO Console support' CONFIG_TXX927_SERIAL_CONSOLE  
     fi                             
     if [ "$CONFIG_SIBYTE_SB1250" = "y" ]; then
        bool '  Support for sb1250 onchip DUART' CONFIG_SIBYTE_SB1250_DUART
        if [ "$CONFIG_SIBYTE_SB1250_DUART" = "y" ]; then
  	  bool '  Console on SB1250 DUART' CONFIG_SIBYTE_SB1250_DUART_CONSOLE
  	  if [ "$CONFIG_SIBYTE_SB1250_DUART_CONSOLE" = "y" ]; then
  	    define_bool CONFIG_SERIAL_CONSOLE y
  	  fi
  	  int  '  Output buffers size (in bytes)' CONFIG_SB1250_DUART_OUTPUT_BUF_SIZE 1024
  	  bool '  Leave port 1 alone (for kgdb or audio)' CONFIG_SIBYTE_SB1250_DUART_NO_PORT_1
        fi
     fi
   fi
fi
if [ "$CONFIG_MIPS_ITE8172" = "y" -o "$CONFIG_MIPS_SNSC_MPU210" = "y" ]; then
   bool 'Enable Qtronix 990P Keyboard Support' CONFIG_QTRONIX_KEYBOARD
   if [ "$CONFIG_QTRONIX_KEYBOARD" = "y" ]; then
     define_bool CONFIG_IT8172_CIR y
   else
     bool '    Enable PS2 Keyboard Support' CONFIG_PC_KEYB
   fi
   bool 'Enable Smart Card Reader 0 Support ' CONFIG_IT8172_SCR0
   bool 'Enable Smart Card Reader 1 Support ' CONFIG_IT8172_SCR1
fi
if [ "$CONFIG_MIPS_IVR" = "y" ]; then
   bool 'Enable Qtronix 990P Keyboard Support' CONFIG_QTRONIX_KEYBOARD
   if [ "$CONFIG_QTRONIX_KEYBOARD" = "y" ]; then
     define_bool CONFIG_IT8172_CIR y
   fi
   bool 'Enable Smart Card Reader 0 Support ' CONFIG_IT8172_SCR0
fi
if [ "$CONFIG_VR4122" = "y" -o "$CONFIG_VR4131" = "y" ]; then
   bool 'NEC VRC4173 support' CONFIG_VRC4173
   if [ "$CONFIG_VRC4173" != "n" ]; then
     bool '    Enable PS/2 Unit Support' CONFIG_VRC4173_PS2U
     bool '    Enable Touch Panel Interface Unit Support' CONFIG_VRC4173_PIU
   fi
fi

tristate 'Sony NSC keypad support' CONFIG_SNSC_KPAD
if [ "$CONFIG_DRAGONBALL_SNSC_MPU110" = "y" ]; then
    dep_tristate '  MPU-110 keypad support' CONFIG_SNSC_MPU110_KPAD $CONFIG_SNSC_KPAD
fi

if [ "$CONFIG_SNSC_MPU200" = "y" ]; then
      bool 'MPU-200 KeyPad Support' CONFIG_SNSC_MPU200_KPAD
      if [ "$CONFIG_SNSC_MPU200_KPAD" != "y" ]; then
         bool 'PC Keyboard Support' CONFIG_PC_KEYB
      fi
fi

if [ "$CONFIG_SNSC_MPU300" = "y" ]; then
   tristate 'MPU-300 FAN control Support' CONFIG_SNSC_MPU300_FANCTL
   tristate 'MPU-300 SuperIO GPIO Support' CONFIG_SNSC_MPU300_SIOGPIO
   dep_tristate '  MPU-301 SuperIO GPIO keypad support' CONFIG_SNSC_MPU301_KPAD $CONFIG_SNSC_KPAD $CONFIG_SNSC_MPU300_SIOGPIO
fi

if [ "$CONFIG_EXPERIMENTAL" = "y" -a "$CONFIG_ZORRO" = "y" ]; then
   tristate 'Commodore A2232 serial support (EXPERIMENTAL)' CONFIG_A2232
fi

if [ "$CONFIG_SERIAL" = "n" ]; then
   source drivers/serial/Config.in
fi

bool 'Unix98 PTY support' CONFIG_UNIX98_PTYS
if [ "$CONFIG_UNIX98_PTYS" = "y" ]; then
   int 'Maximum number of Unix98 PTYs in use (0-2048)' CONFIG_UNIX98_PTY_COUNT 256
fi
if [ "$CONFIG_PARPORT" != "n" ]; then
   dep_tristate 'Parallel printer support' CONFIG_PRINTER $CONFIG_PARPORT
   if [ "$CONFIG_PRINTER" != "n" ]; then
      bool '  Support for console on line printer' CONFIG_LP_CONSOLE
   fi
   dep_tristate 'Support for user-space parallel port device drivers' CONFIG_PPDEV $CONFIG_PARPORT
fi
if [ "$CONFIG_SA1100_PFS168" = "y" ]; then
   dep_tristate 'PFS-168 SPI char device driver' CONFIG_PFS168_SPI $CONFIG_SA1100_PFS168
   dep_tristate 'PFS-168 Miscellaneous I/O access via proc' CONFIG_PFS168_MISC $CONFIG_SA1100_PFS168
fi
if [ "$CONFIG_SA1100_H3XXX" = "y" ]; then
   comment 'Compaq iPAQ H3600 support'
   dep_tristate '  Toucnscreen support' CONFIG_TOUCHSCREEN_H3600 $CONFIG_H3600_HARDWARE
   dep_tristate '  Backpaq FPGA driver interface' CONFIG_H3600_BACKPAQ_FPGA $CONFIG_MERCURY_BACKPAQ
   dep_tristate '  Backpaq accelerometer interface' CONFIG_H3600_BACKPAQ_ACCEL $CONFIG_H3600_BACKPAQ_FPGA
   dep_tristate '  Backpaq gasgauge interface' CONFIG_H3600_BACKPAQ_GASGAUGE $CONFIG_H3600_BACKPAQ_FPGA
   tristate '  Stowaway keyboard support' CONFIG_H3600_STOWAWAY
   tristate 'Linux Consumer IR Driver (LIRC) for iPAQ' CONFIG_SA1100_LIRC
fi

source drivers/i2c/Config.in

if [ "$CONFIG_ARM" = "y" ]; then
   # This has dependencies on I2C and therefore_must_ come after I2C.
   source drivers/l3/Config.in
fi

source drivers/sensors/Config.in

mainmenu_option next_comment
comment 'Mice'
tristate 'Bus Mouse Support' CONFIG_BUSMOUSE
if [ "$CONFIG_BUSMOUSE" != "n" ]; then
   dep_tristate '  ATIXL busmouse support' CONFIG_ATIXL_BUSMOUSE $CONFIG_BUSMOUSE
   dep_tristate '  Logitech busmouse support' CONFIG_LOGIBUSMOUSE $CONFIG_BUSMOUSE
   dep_tristate '  Microsoft busmouse support' CONFIG_MS_BUSMOUSE $CONFIG_BUSMOUSE
   if [ "$CONFIG_ADB" = "y" -a "$CONFIG_ADB_KEYBOARD" = "y" ]; then
      dep_tristate '  Apple Desktop Bus mouse support (old driver)' CONFIG_ADBMOUSE $CONFIG_BUSMOUSE
   fi
fi

tristate 'Mouse Support (not serial and bus mice)' CONFIG_MOUSE
if [ "$CONFIG_MOUSE" != "n" ]; then
   bool '  PS/2 mouse (aka "auxiliary device") support' CONFIG_PSMOUSE
   tristate '  C&T 82C710 mouse port support (as on TI Travelmate)' CONFIG_82C710_MOUSE
   tristate '  PC110 digitizer pad support' CONFIG_PC110_PAD
fi

if [ "$CONFIG_PPC" = "y" ]; then
	tristate 'Redwood IR mouse driver' CONFIG_RWMOUSE
fi
endmenu

source drivers/char/joystick/Config.in
source drivers/char/akmem/Config.in

tristate 'QIC-02 tape support' CONFIG_QIC02_TAPE
if [ "$CONFIG_QIC02_TAPE" != "n" ]; then
   bool '  Do you want runtime configuration for QIC-02' CONFIG_QIC02_DYNCONF
   if [ "$CONFIG_QIC02_DYNCONF" != "y" ]; then
      comment '  Edit configuration parameters in ./include/linux/tpqic02.h!'
   else
      comment '  Setting runtime QIC-02 configuration is done with qic02conf'
      comment '  from the tpqic02-support package.  It is available at'
      comment '  metalab.unc.edu or ftp://titus.cfw.com/pub/Linux/util/'
   fi
fi

mainmenu_option next_comment
comment 'Watchdog Cards'
bool 'Watchdog Timer Support'	CONFIG_WATCHDOG
if [ "$CONFIG_WATCHDOG" != "n" ]; then
   bool '  Disable watchdog shutdown on close' CONFIG_WATCHDOG_NOWAYOUT
   tristate '  Software Watchdog' CONFIG_SOFT_WATCHDOG
   tristate '  WDT Watchdog timer' CONFIG_WDT
   tristate '  WDT PCI Watchdog timer' CONFIG_WDTPCI
   if [ "$CONFIG_WDT" != "n" ]; then
      bool '    WDT501 features' CONFIG_WDT_501
      if [ "$CONFIG_WDT_501" = "y" ]; then
         bool '      Fan Tachometer' CONFIG_WDT_501_FAN
      fi
   fi
   tristate '  Berkshire Products PC Watchdog' CONFIG_PCWATCHDOG
   tristate '  Acquire SBC Watchdog Timer' CONFIG_ACQUIRE_WDT
   tristate '  Advantech SBC Watchdog Timer' CONFIG_ADVANTECH_WDT
   if [ "$CONFIG_ARM" = "y" ]; then
      dep_tristate '  DC21285 watchdog' CONFIG_21285_WATCHDOG $CONFIG_FOOTBRIDGE
      dep_tristate '  NetWinder WB83C977 watchdog' CONFIG_977_WATCHDOG $CONFIG_ARCH_NETWINDER
      dep_tristate '  SA1100 watchdog' CONFIG_SA1100_WATCHDOG $CONFIG_ARCH_SA1100
   fi
   tristate '  Eurotech CPU-1220/1410 Watchdog Timer' CONFIG_EUROTECH_WDT
   tristate '  IB700 SBC Watchdog Timer' CONFIG_IB700_WDT
   tristate '  Intel i810 TCO timer / Watchdog' CONFIG_I810_TCO
   tristate '  Mixcom Watchdog' CONFIG_MIXCOMWD 
   tristate '  SBC-60XX Watchdog Timer' CONFIG_60XX_WDT
   tristate '  W83877F (EMACS) Watchdog Timer' CONFIG_W83877F_WDT
   tristate '  ZF MachZ Watchdog' CONFIG_MACHZ_WDT
   if [ "$CONFIG_4xx" = "y" ]; then
      tristate '  IBM PPC 405 Watchdog Timer' CONFIG_PPC405_WDT
   fi
   dep_tristate '  NEC VR41xx Watchdog (DSU)' CONFIG_VR41XX_WDT $CONFIG_CPU_VR41XX
   dep_tristate '  Dragonball MX1 Watchdog Timer' CONFIG_DBMX1_WDT $CONFIG_ARCH_DRAGONBALL
fi
endmenu

if [ "$CONFIG_ARCH_NETWINDER" = "y" ]; then
   tristate 'NetWinder thermometer support' CONFIG_DS1620
   tristate 'NetWinder Button' CONFIG_NWBUTTON
   if [ "$CONFIG_NWBUTTON" != "n" ]; then
      bool '  Reboot Using Button' CONFIG_NWBUTTON_REBOOT
   fi
   tristate 'NetWinder flash support' CONFIG_NWFLASH
fi

dep_tristate 'Intel i8x0 Random Number Generator support' CONFIG_INTEL_RNG $CONFIG_PCI
tristate '/dev/nvram support' CONFIG_NVRAM
tristate 'Enhanced Real Time Clock Support' CONFIG_RTC
if [ "$CONFIG_IA64" = "y" ]; then
   bool 'EFI Real Time Clock Services' CONFIG_EFI_RTC
fi
if [ "$CONFIG_OBSOLETE" = "y" -a "$CONFIG_ALPHA_BOOK1" = "y" ]; then
   bool 'Tadpole ANA H8 Support'  CONFIG_H8
fi
if [ "$CONFIG_MIPS" = "y" -a "$CONFIG_NEW_TIME_C" = "y" ]; then
   tristate 'Generic MIPS RTC Support' CONFIG_MIPS_RTC
fi
if [ "$CONFIG_ARCH_SA1100" = "y" ]; then
   tristate 'SA1100 Real Time Clock' CONFIG_SA1100_RTC
fi
if [ "$CONFIG_ARCH_DRAGONBALL" = "y" ]; then
   tristate 'Dragonball RTC Support' CONFIG_SNSC_MPU110_RTC
fi

tristate 'Double Talk PC internal speech card support' CONFIG_DTLK
tristate 'Siemens R3964 line discipline' CONFIG_R3964
tristate 'Applicom intelligent fieldbus card support' CONFIG_APPLICOM
if [ "$CONFIG_EXPERIMENTAL" = "y" -a "$CONFIG_X86" = "y" ]; then
   dep_tristate 'Sony Vaio Programmable I/O Control Device support' CONFIG_SONYPI $CONFIG_PCI
fi
if [ "$CONFIG_405GP" = "y" ]; then
   tristate 'IBM PPC 405 GPIO' CONFIG_PPC405_GPIO
fi

mainmenu_option next_comment
comment 'Ftape, the floppy tape device driver'
tristate 'Ftape (QIC-80/Travan) support' CONFIG_FTAPE
if [ "$CONFIG_FTAPE" != "n" ]; then
   source drivers/char/ftape/Config.in
fi
endmenu

dep_tristate '/dev/agpgart (AGP Support)' CONFIG_AGP $CONFIG_DRM_AGP
if [ "$CONFIG_AGP" != "n" ]; then
   bool '  Intel 440LX/BX/GX and I815/I830M/I840/I850 support' CONFIG_AGP_INTEL
   bool '  Intel I810/I815/I830M (on-board) support' CONFIG_AGP_I810
   bool '  VIA chipset support' CONFIG_AGP_VIA
   bool '  AMD Irongate, 761, and 762 support' CONFIG_AGP_AMD
   bool '  Generic SiS support' CONFIG_AGP_SIS
   bool '  ALI chipset support' CONFIG_AGP_ALI
   bool '  Serverworks LE/HE support' CONFIG_AGP_SWORKS
fi

source drivers/char/drm/Config.in

if [ "$CONFIG_HOTPLUG" = "y" -a "$CONFIG_PCMCIA" != "n" ]; then
   source drivers/char/pcmcia/Config.in
fi
if [ "$CONFIG_MIPS_AU1000" = "y" ]; then
   tristate ' Alchemy Au1000 GPIO device support' CONFIG_AU1000_GPIO
fi
if [ "$CONFIG_MIPS_ITE8172" = "y" -o "$CONFIG_MIPS_SNSC_MPU210" = "y" ]; then
  tristate ' ITE GPIO' CONFIG_ITE_GPIO
fi
if [ "$CONFIG_MIPS" = "y" -a "$CONFIG_CPU_HAS_LLSC" = "n" ]; then
   tristate '  MIPS common fast test and set support' CONFIG_MIPS_TAS_DEV
fi

if [ "$CONFIG_X86" = "y" ]; then
   tristate 'ACP Modem (Mwave) support' CONFIG_MWAVE

   if [ "$CONFIG_SNSC_MPU300" = "y" ]; then
      tristate ' BU9929FV GPIO device support' CONFIG_SNSC_BU9929_GPIO
        if [ "$CONFIG_SNSC_BU9929_GPIO" != "n" ]; then
           bool '    enable I2C functions in interrupt time' CONFIG_SNSC_MPU300_INTRI2C
        fi
      tristate ' ICH2 GPIO device support' CONFIG_SNSC_ICH_GPIO
      if [ "$CONFIG_SNSC_BU9929_GPIO" = "y" -a "$CONFIG_SNSC_ICH_GPIO" = "y" \
	  -a "$CONFIG_I2C_I801" = "y" -a "$CONFIG_I2C" = "y" -a "$CONFIG_I2C_PROC" = "y" ]; then
	 bool ' MPU-300 KeyPad Support' CONFIG_SNSC_MPU300_KPAD
      fi
   fi
fi

if [ "$CONFIG_ARCH_DRAGONBALL" = "y" ]; then
    dep_tristate 'DragonBall Generic GPIO' CONFIG_DRAGONBALL_GENERIC_GPIO $CONFIG_ARCH_DRAGONBALL
fi
if [ "$CONFIG_DRAGONBALL_SNSC_MPU110" = "y" ]; then
    tristate 'MPU-110 PWM support' CONFIG_SNSC_MPU110_PWM
fi
if [ "$CONFIG_SNSC" = "y" -a "$CONFIG_PM" = "y" ]; then
    tristate 'Sony NSC Power Management support' CONFIG_NPM
fi


endmenu
```
