## drivers/mtd/nand/Config.in
```kconfig
# drivers/mtd/nand/Config.in

# $Id: Config.in,v 1.9 2002/08/29 21:44:14 gleixner Exp $

mainmenu_option next_comment

comment 'NAND Flash Device Drivers'

dep_tristate '  NAND Device Support' CONFIG_MTD_NAND $CONFIG_MTD
if [ "$CONFIG_MTD_NAND" = "y" -o "$CONFIG_MTD_NAND" = "m" ]; then
   bool '    Enable ECC correction algorithm'  CONFIG_MTD_NAND_ECC
   bool '    Verify NAND page writes' CONFIG_MTD_NAND_VERIFY_WRITE
   bool '    Enable bad block force erase' CONFIG_MTD_NAND_FORCE_ERASE
fi

if [ "$CONFIG_ARM" = "y" -a "$CONFIG_ARCH_P720T" = "y" ]; then
   dep_tristate '  NAND Flash device on SPIA board' CONFIG_MTD_NAND_SPIA $CONFIG_MTD_NAND
fi

if [ "$CONFIG_ARCH_AUTCPU12" = "y" ]; then
   dep_tristate ' SmartMedia Card on AUTCPU12 board' CONFIG_MTD_NAND_AUTCPU12 $CONFIG_MTD_NAND
fi

if [ "$CONFIG_ARCH_EDB7312" = "y" ]; then
   dep_tristate '  NAND Flash device on EDP7312 board' CONFIG_MTD_NAND_EDB7312 $CONFIG_MTD_NAND
fi

if [ "$CONFIG_DRAGONBALL_SNSC_MPU110" = "y" ]; then
   dep_tristate ' MPU-110 onboard NAND flash' CONFIG_MTD_NAND_MPU110 $CONFIG_MTD_NAND
fi

   if [ "$CONFIG_MTD_NAND_SCALLOP" = "y" -o "$CONFIG_MTD_NAND_SCALLOP" = "m" ]; then
      bool '   Ready/Busy loop counter available under /proc fs' CONFIG_MTD_NAND_PROC_BUSY
   fi

if [ "$CONFIG_DRAGONBALL_EBOOK" = "y" ]; then
   dep_tristate ' EBOOK-1 onboard NAND flash' CONFIG_MTD_NAND_EBOOK $CONFIG_MTD_NAND
   if [ "$CONFIG_MTD_NAND_EBOOK" = "y" -o "$CONFIG_MTD_NAND_EBOOK" = "m" ]; then
   choice 'EBOOK-1 NAND type' \
          "48MB    CONFIG_MTD_NAND_EBOOK_48 \
           64MB    CONFIG_MTD_NAND_EBOOK_64" 48MB
   fi
fi

if [ "$CONFIG_MIPS" = "y" -a "$CONFIG_SNSC_MPU200" = "y" ]; then
   dep_tristate '  NAND Flash device on SNSC MPU-200 board' CONFIG_MTD_NAND_MPU200 $CONFIG_MTD_NAND
fi

if [ "$CONFIG_MIPS" = "y" -a "$CONFIG_MIPS_SNSC_MPU210" = "y" ]; then
   dep_tristate '  NAND Flash device on SNSC MPU-210 board' CONFIG_MTD_NAND_MPU210 $CONFIG_MTD_NAND
fi

endmenu
```

## net/ipv6/Config.in
```kconfig
# $USAGI: Config.in,v 1.52 2002/03/01 08:20:26 yoshfuji Exp $
#
# IPv6 configuration
#

#mainmenu_option next_comment
#comment '  IPv6 Configuration'

# --- overall ---
bool '    IPv6: Verbose debugging messages' CONFIG_IPV6_DEBUG

# --- module interface ---
if [ "$CONFIG_NETLINK" = "y" ]; then
   if [ "$CONFIG_RTNETLINK" = "n" ]; then
      bool '    IPv6: routing messages via old netlink' CONFIG_IPV6_NETLINK
   fi
fi
if [ "$CONFIG_IPV6" = "m" ]; then
   bool '    IPv6: inter-module support.' CONFIG_IPV6_IM
   if [ "$CONFIG_NET_IPGRE" != "n" ]; then
      bool '      IPv6: enable gre tunnel support with modulized ipv6' CONFIG_IPV6_MODULE_IP_GRE
   fi
fi

# --- IPv6 Specification (RFC2460) and Addressing Architecture (RFC2373) ---
#bool '    IPv6: Loose scope_id' CONFIG_IPV6_LOOSE_SCOPE_ID
bool '    IPv6: drop packets with fake ipv4-mapped address(es)' CONFIG_IPV6_DROP_FAKE_V4MAPPED
bool '    IPv6: Moderate double binding behavior' CONFIG_IPV6_MODERATE_DOUBLE_BIND
bool '    IPv6: 6to4-address in nexthop support.' CONFIG_IPV6_6TO4_NEXTHOP
bool '    IPv6: Privacy Extensions (RFC 3041) support' CONFIG_IPV6_PRIVACY
bool '    IPv6: anycast support' CONFIG_IPV6_ANYCAST

# --- ISATAP interface ---
if [ "$CONFIG_EXPERIMENTAL" = "y" ]; then
    bool '    IPv6: ISATAP interface support (EXPERIMENTAL)' CONFIG_IPV6_ISATAP
fi

# --- NDP (RFC2461) ---
bool '    IPv6: Prefix List support' CONFIG_IPV6_PREFIXLIST
if [ "$CONFIG_IPV6_DEBUG" = "y" ]; then
   bool '    IPv6: Neighbor Discovery debugging' CONFIG_IPV6_NDISC_DEBUG
fi

# --- Stateless Address Configuration (RFC2462) ---
if [ "$CONFIG_IPV6_DEBUG" = "y" ]; then
   bool '    IPv6: Address Autoconfigration debugging' CONFIG_IPV6_ACONF_DEBUG
   if [ "$CONFIG_IPV6_DEBUG" = "y" ]; then
      bool '     IPv6: Debug on source address selection' CONFIG_IPV6_ACONF_DEBUG_SADDR
   fi
fi

# --- Routing ---
if [ "$CONFIG_IPV6_DEBUG" = "y" ]; then
   bool '    IPv6: Routing Informtation debugging' CONFIG_IPV6_RT6_DEBUG
fi
bool '    IPv6: allow default route when forwarding is enabled' CONFIG_IPV6_EN_DFLT

# --- MLD (RFC2710) ---
if [ "$CONFIG_IPV6_DEBUG" = "y" ]; then
   bool '    IPv6: Multicast Listener Discovery debugging' CONFIG_IPV6_MLD6_DEBUG
fi
bool '    IPv6: Do not suppress MLD6 Done message' CONFIG_IPV6_MLD6_NO_SUPPRESS_DONE

# --- Node Information Queries (Internet Draft) ---
bool '    IPv6: enable Node Information Queries' CONFIG_IPV6_NODEINFO
if [ "$CONFIG_IPV6_NODEINFO" = "y" ]; then
   if [ "$CONFIG_IPV6_DEBUG" = "y" ]; then
       bool '      IPv6: Node Information Queries debugging' CONFIG_IPV6_NODEINFO_DEBUG
   fi
   bool '      IPv6: regard NIS domain as DNS domain' CONFIG_IPV6_NODEINFO_USE_UTS_DOMAIN
fi

# --- Socket Interface (RFC2292, RFC2553) ---

# --- Filtering ---
if [ "$CONFIG_NETFILTER" != "n" ]; then
   source net/ipv6/netfilter/Config.in
fi

# --- Misc. ---
#bool '    IPv6: flow policy support' CONFIG_RT6_POLICY
#bool '    IPv6: firewall support' CONFIG_IPV6_FIREWALL

# -- IPsec --
if [ "$CONFIG_EXPERIMENTAL" = "y" ]; then
   if [ "$CONFIG_IPV6_MOBILITY_AH" != "y" ] ; then
      if [ "$CONFIG_IPSEC" != "n" ] ; then
         bool '    IPv6: IP Security Support (EXPERIMENTAL)' CONFIG_IPV6_IPSEC 

         if [ "$CONFIG_IPV6_IPSEC" = "y" ]; then
            bool '    IPv6: Apply IPsec to ICMPv6 packets' CONFIG_APPLY_ICMPV6_IPSEC 
         fi
       fi
    fi
fi

# --- Mobile IP ---
dep_tristate '    IPv6: IPv6 over IPv6 Tunneling (EXPERIMENTAL)' CONFIG_IPV6_IPV6_TUNNEL m
if [ "$CONFIG_EXPERIMENTAL" = "y" ]; then
   if [ "$CONFIG_NETFILTER" = "y" ]; then
      source net/ipv6/mobile_ip6/Config.in
   fi
fi

#endmenu
```

## security/Config.in
```kconfig
#
# Security configuration
#
mainmenu_option next_comment
comment 'Security options'
bool ' Linux Security Modules (LSM) Support' CONFIG_SECURITY
if [ "$CONFIG_SECURITY" = "y" ]; then 
   tristate 'Capabilities Support' CONFIG_SECURITY_CAPABILITIES
   dep_tristate 'LSM port of Openwall (EXPERIMENTAL)' CONFIG_SECURITY_OWLSM $CONFIG_EXPERIMENTAL
   if [ "$CONFIG_SECURITY_OWLSM" = "y" -o "$CONFIG_SECURITY_OWLSM" = "m" ]; then
	bool '  Add RLIMITS_NPROC check to execve' CONFIG_OWLSM_RLIMIT_NPROC
	bool '  Restricted links in /tmp' CONFIG_OWLSM_LINK
	bool '  Special handling of fd 0, 1, and 2' CONFIG_OWLSM_FD
   fi
   source security/lids/Config.in
   #dep_tristate 'Linux Intrusion Detection System(EXPERIMENTAL)' CONFIG_LIDS $CONFIG_EXPERIMENTAL
fi
endmenu
```
